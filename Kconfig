## Kconfig
```kconfig
mainmenu "AircraftWar Configuration Menu"

config M_CONFIG_TEST_READ
    string
    default "OK"

config DEBUG
    bool "Debug switch"
    default y

menu "Window config"
    config M_WINDOW_WIDTH
        int "Window Width"
        default 512

    config M_WINDOW_HEIGHT
        int "Window Height"
        default 768

    config M_WINDOW_FULL_SCREEN
        bool "Launch in fullscreen"
        default n

    config M_WINDOW_PLAY_WIDTH
        int "Playground Width"
        default 512

    config M_WINDOW_PLAY_HEIGHT
        int "Playground Height"
        default 768

    config M_WINDOW_PLAY_OFFSET_X
        int "Playground Offset X"
        default 64

    config M_WINDOW_PLAY_OFFSET_Y
        int "Playground Offset Y"
        default 28

    config M_WINDOW_BG_COLOR
        hex "Window background color"
        default 0x3f3f3f3f

endmenu

menu "Control config"
    config M_CONTROL_MOVE_SPEED
        int "Keyboard move speed"
        default 1000

    config M_CONTROL_KEYCODE_UP
        int "Keycode: up"
        default 38

    config M_CONTROL_KEYCODE_DOWN
        int "Keycode: down"
        default 40

    config M_CONTROL_KEYCODE_LEFT
        int "Keycode: left"
        default 37

    config M_CONTROL_KEYCODE_RIGHT
        int "Keycode: right"
        default 39

    config M_CONTROL_KEYCODE_SLOW
        int "Keycode: slow mode"
        default 16

    config M_CONTROL_KEYCODE_BUFF
        int "Keycode: use buff"
        default 88

    config M_CONTROL_KEYCODE_SHOOT
        int "Keycode: shoot"
        default 90

    config M_CONTROL_KEYCODE_QUIT
        int "Keycode: quit"
        default 81

endmenu

menu "Running config"
    config M_RUNNING_SHOW_FPS
        bool "Print fps info in console"
        default n
endmenu

menu "Hero config"
    config M_HERO_BOX
       int "Hero judging box size"
       default 12

    config M_HERO_POWER_STEPS
        string "Set bullet power steps"
        default "5,15,30,60"
endmenu
```
